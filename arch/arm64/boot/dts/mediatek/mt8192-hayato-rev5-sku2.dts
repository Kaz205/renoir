// SPDX-License-Identifier: (GPL-2.0 OR MIT)
/*
 * Copyright 2022 Google LLC
 */
/dts-v1/;
#include "mt8192-asurada.dtsi"
#include "mt8192-asurada-audio-rt1015p-rt5682s.dtsi"

/ {
	model = "MediaTek Hayato rev5 board";
	compatible = "google,hayato-rev5-sku2", "google,hayato-sku2", "mediatek,mt8192";
};
