// SPDX-License-Identifier: (GPL-2.0 OR MIT)
/*
 * Copyright (C) 2022 MediaTek Inc.
 */
#include "mt8192-asurada-audio-rt5682s.dtsi"
#include "mt8192-asurada-audio-rt1015p.dtsi"

&sound {
	compatible = "mediatek,mt8192_mt6359_rt1015p_rt5682s";
	speaker-codecs {
		sound-dai = <&rt1015p>;
	};
	headset-codec {
		sound-dai = <&rt5682s>;
	};
};
