// SPDX-License-Identifier: (GPL-2.0 OR MIT)
/*
 * Copyright 2021 Google LLC
 */
/dts-v1/;
#include "mt8192-asurada.dtsi"
#include "mt8192-asurada-audio-rt1015p-rt5682.dtsi"

/ {
	model = "MediaTek Spherion rev0 board";
	compatible = "google,spherion-rev0", "google,spherion", "mediatek,mt8192";
};
