// SPDX-License-Identifier: (GPL-2.0 OR MIT)
/*
 * Copyright 2020 Google LLC
 */
#include "mt8192-asurada-audio-rt5682.dtsi"
#include "mt8192-asurada-audio-rt1015.dtsi"

&sound {
	compatible = "mediatek,mt8192_mt6359_rt1015_rt5682";
	speaker-codecs {
		sound-dai = <&rt1015_l>,
			    <&rt1015_r>;
	};
	headset-codec {
		sound-dai = <&rt5682>;
	};
};
