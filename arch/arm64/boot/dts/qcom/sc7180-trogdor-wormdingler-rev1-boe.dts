// SPDX-License-Identifier: (GPL-2.0+ OR MIT)
/*
 * Google Wormdingler board device tree source
 *
 * Copyright 2021 Google LLC.
 *
 * SKU: 0x30 => 48
 *  - bits 7..4: Panel ID: 0x3 (BOE)
 */

/dts-v1/;

#include "sc7180-trogdor-wormdingler.dtsi"

/ {
	model = "Google Wormdingler rev1+ BOE panel board";
	compatible = "google,wormdingler-sku48", "qcom,sc7180";
};

&panel {
	compatible = "boe,tv110c9m-ll3";
};
