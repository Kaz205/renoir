## Documentation/devicetree/bindings/iio/proximity/semtech,sx9310.yaml
```yaml
# SPDX-License-Identifier: (GPL-2.0-only OR BSD-2-Clause)
%YAML 1.2
---
$id: http://devicetree.org/schemas/iio/proximity/semtech,sx9310.yaml#
$schema: http://devicetree.org/meta-schemas/core.yaml#

title: Semtech's SX9310 capacitive proximity sensor

maintainers:
  - Daniel Campello <campello@chromium.org>

description: |
  Semtech's SX9310/SX9311 capacitive proximity/button solution.

  Specifications about the devices can be found at:
  https://www.semtech.com/products/smart-sensing/sar-sensors/sx9310

properties:
  compatible:
    enum:
      - semtech,sx9310
      - semtech,sx9311

  reg:
    maxItems: 1

  interrupts:
    description:
      The sole interrupt generated by the device used to announce the
      preceding reading request has finished and that data is
      available or that a close/far proximity event has happened.
    maxItems: 1

  power-supply: true

required:
  - compatible
  - reg
  - power-supply

additionalProperties: false

examples:
  - |
    #include <dt-bindings/interrupt-controller/irq.h>
    i2c {
      #address-cells = <1>;
      #size-cells = <0>;
      proximity@28 {
        compatible = "semtech,sx9310";
        reg = <0x28>;
        interrupt-parent = <&pio>;
        interrupts = <5 IRQ_TYPE_LEVEL_LOW 5>;
        power-supply = <...>;
      };
    };
```

## Documentation/devicetree/bindings/sound/qcom,sc7180.yaml
```yaml
# SPDX-License-Identifier: (GPL-2.0-only OR BSD-2-Clause)
%YAML 1.2
---
$id: http://devicetree.org/schemas/sound/qcom,sc7180.yaml#
$schema: http://devicetree.org/meta-schemas/core.yaml#

title: Qualcomm Technologies Inc. SC7180 ASoC sound card driver

maintainers:
  - Rohit kumar <rohitkr@codeaurora.org>
  - Cheng-Yi Chiang <cychiang@chromium.org>

description:
  This binding describes the SC7180 sound card which uses LPASS for audio.

properties:
  compatible:
    const: qcom,sc7180-sndcard-rt5682-m98357-1mic

  audio-routing:
    $ref: /schemas/types.yaml#/definitions/non-unique-string-array
    description:
      A list of the connections between audio components. Each entry is a
      pair of strings, the first being the connection's sink, the second
      being the connection's source.

  model:
    $ref: /schemas/types.yaml#/definitions/string
    description: User specified audio sound card name

  "#address-cells":
    const: 1

  "#size-cells":
    const: 0

patternProperties:
  "^dai-link(@[0-9])?$":
    description:
      Each subnode represents a dai link. Subnodes of each dai links would be
      cpu/codec dais.

    type: object

    properties:
      link-name:
        description: Indicates dai-link name and PCM stream name.
        $ref: /schemas/types.yaml#/definitions/string
        maxItems: 1

      reg:
        description: dai link address.

      cpu:
        description: Holds subnode which indicates cpu dai.
        type: object
        properties:
          sound-dai: true

      codec:
        description: Holds subnode which indicates codec dai.
        type: object
        properties:
          sound-dai: true

    required:
      - link-name
      - cpu
      - codec

    additionalProperties: false

required:
  - compatible
  - model
  - "#address-cells"
  - "#size-cells"

additionalProperties: false

examples:

  - |
    sound {
        compatible = "qcom,sc7180-sndcard-rt5682-m98357-1mic";
        model = "sc7180-snd-card";

        audio-routing =
                    "Headphone Jack", "HPOL",
                    "Headphone Jack", "HPOR";

        #address-cells = <1>;
        #size-cells = <0>;

        dai-link@0 {
            link-name = "MultiMedia0";
            reg = <0>;
            cpu {
                sound-dai = <&lpass_cpu 0>;
            };

            codec {
                sound-dai = <&alc5682 0>;
            };
        };

        dai-link@1 {
            link-name = "MultiMedia1";
            reg = <1>;
            cpu {
                sound-dai = <&lpass_cpu 1>;
            };

            codec {
                sound-dai = <&max98357a>;
            };
        };

        dai-link@2 {
            link-name = "MultiMedia2";
            reg = <2>;
            cpu {
                sound-dai = <&lpass_hdmi 0>;
            };

            codec {
                sound-dai = <&msm_dp>;
            };
        };
    };
```

## drivers/media/platform/camx/Kconfig
```kconfig
#
# Qualcomm camera configuration
#

menuconfig SPECTRA_CAMERA
	bool "Qualcomm Technologies, Inc. Spectra Camera"
	depends on (ARCH_QCOM)
	depends on (MEDIA_SUPPORT && MEDIA_CONTROLLER && V4L_PLATFORM_DRIVERS)
	depends on (VIDEO_DEV && VIDEO_V4L2=y)
	depends on ARM64
	depends on !COMPILE_TEST
	depends on SC_CAMCC_7180
	help
	  Say Y here to enable selecting the video adapters for
	  Qualcomm Technologies, Inc. Spectra camera and video capture.
	  Enabling this adds support for the camera driver stack including sensor,
	  IFE and postprocessing drivers.

if SPECTRA_CAMERA

config QTI_CAMERA_SYNC
        bool "Qualcomm camera SYNC driver"
	default y
        help
	  Say Y here to enable selecting module
          Support for camera drivers synchronization

config QTI_CAMERA_SMMU
        bool "Qualcomm System Memory Management Unit (SMMU)"
	default y
	depends on (IOMMU_DMA)
        help
	  Say Y here to enable selecting module
          Support for memory pools and context banks

config QTI_CAMERA_CRM
        bool "Qualcomm Camera Request Manager (CRM)"
	default y
	depends on (QTI_CAMERA_SYNC && QTI_CAMERA_SMMU)
	select VIDEOBUF2_DMA_SG
        help
	  Say Y here to enable selecting module
          Support for camera drivers memory requests

config QTI_ISP
        bool "Qualcomm ISP drivers"
	depends on (QTI_CAMERA_SYNC && QTI_CAMERA_SMMU && QTI_CAMERA_CRM)
	default y
        help
	  Say Y here to enable selecting module
	  Support for the ISP engine

config QTI_ICP_A5
        bool "Qualcomm ICP/A5 driver"
	depends on (QTI_CAMERA_SYNC && QTI_CAMERA_SMMU && QTI_CAMERA_CRM)
	default y
        help
	  Say Y here to enable selecting module
          Support for the ICP/A5 engine

config QTI_CPAS
        bool "Qualcomm CPAS driver"
	default y
	depends on (QTI_CAMERA_SYNC && QTI_CAMERA_SMMU && QTI_CAMERA_CRM)
	depends on QCOM_CLK_RPMH
	depends on INTERCONNECT_QCOM_SC7180
        help
	  Say Y here to enable selecting module
          Support for CDMx engines SW interface

config QTI_JPEG
        bool "Qualcomm JPEG driver"
	default n
	depends on (QTI_CAMERA_SYNC && QTI_CAMERA_SMMU && QTI_CAMERA_CRM)
        help
	  Say Y here to enable selecting module
          Support for the JPEG engine

config QTI_LRME
        bool "Qualcomm LRME driver"
	default n
	depends on (QTI_CAMERA_SYNC && QTI_CAMERA_SMMU && QTI_CAMERA_CRM)
        help
	  Say Y here to enable selecting module
          Support for the LRME engine

config QTI_SENSORS
        bool "Qualcomm sensor drivers"
	default y
	depends on (QTI_CAMERA_SYNC && QTI_CAMERA_SMMU && QTI_CAMERA_CRM)
        help
	  Say Y here to enable selecting module
          Support for the Sensors and Actuator etc

	if QTI_SENSORS
		config QTI_EEPROM
			bool "Camera EEPROM driver"
			default y
			help
			  Say Y here to enable selecting module
			  Support for the Camera eeprom driver

		config QTI_ACTUATOR
			bool "Camera Actuator driver"
			default n
			help
			  Say Y here to enable selecting module
			  Support for the Camera actuator driver

		config QTI_CCI
			bool "Qualcomm CCI driver"
			default y
			help
			  Say Y here to enable selecting module
			  Support for the synchronous QUP based I2C interface

		config QTI_I2C
			bool "Qualcomm I2C driver"
			default y
			help
			  Say Y here to enable selecting module
			  Support for the synchronous GENI based I2C interface

		config QTI_SPI
			bool "Qualcomm SPI_GENI driver"
			default y
			help
			  Say Y here to enable selecting module
			  Support for the GENI based Serial Peripheral Interface

	endif

endif
```
